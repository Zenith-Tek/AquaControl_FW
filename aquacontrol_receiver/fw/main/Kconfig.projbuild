## aquacontrol_receiver/fw/main/Kconfig.projbuild
```kconfig
menu "Application Configuration"

	choice DIRECTION
		prompt "Communication polarity"
		default SENDER
		help
			Select Communication polarity.
		config SENDER
			bool "As the sender"
			help
				As the sender.
		config RECEIVER
			bool "As the receiver"
			help
				As the receiver.
	endchoice

	config RELAY_GPIO
		int "Relay GPIO Number"
		default 4
		help
			GPIO pin number connected to the relay control input.

	config SWITCH_GPIO
		int "Switch/Button GPIO Number"
		default 16 if IDF_TARGET_ESP32S3
		default 27 if IDF_TARGET_ESP32
		default 16
		help
			GPIO pin number connected to the physical manual toggle button/switch.

endmenu 
```

## aquacontrol_receiver/fw/sdkconfig.defaults
```kconfig
# Custom partition table
CONFIG_PARTITION_TABLE_CUSTOM=y

# Core dump configuration
CONFIG_ESP_COREDUMP_ENABLE_TO_FLASH=y
CONFIG_ESP_COREDUMP_DATA_FORMAT_ELF=y
CONFIG_ESP_COREDUMP_CHECKSUM_CRC32=y
CONFIG_ESP_COREDUMP_CHECK_BOOT=y
CONFIG_ESP_COREDUMP_ENABLE=y
CONFIG_ESP_COREDUMP_LOGS=y
CONFIG_ESP_COREDUMP_MAX_TASKS_NUM=64

# Log timestamp source configuration
CONFIG_LOG_TIMESTAMP_SOURCE_SYSTEM=y
CONFIG_ESP_MAIN_TASK_STACK_SIZE=10240

# mbedtls heap optimizations
CONFIG_MBEDTLS_DYNAMIC_BUFFER=y
CONFIG_MBEDTLS_SSL_VARIABLE_BUFFER_LENGTH=y
```

## aquacontrol_receiver/fw/sdkconfig.defaults.esp32
```kconfig
CONFIG_IDF_TARGET="esp32"
CONFIG_ESPTOOLPY_FLASHSIZE_4MB=y
CONFIG_ESPTOOLPY_FLASHSIZE="4MB"
CONFIG_PARTITION_TABLE_CUSTOM_FILENAME="partitions_esp32.csv"
CONFIG_PARTITION_TABLE_FILENAME="partitions_esp32.csv"

# LoRa GPIO Pin Configuration for ESP32 PCB
CONFIG_MISO_GPIO=12
CONFIG_MOSI_GPIO=13
CONFIG_SCK_GPIO=14
CONFIG_CS_GPIO=15
CONFIG_RST_GPIO=5
CONFIG_SPI2_HOST=y

# Application GPIO Configuration for ESP32 PCB
CONFIG_RELAY_GPIO=4
CONFIG_SWITCH_GPIO=16
```

## aquacontrol_receiver/fw/sdkconfig.defaults.esp32s3
```kconfig
CONFIG_IDF_TARGET="esp32s3"
CONFIG_MISO_GPIO=37
CONFIG_SCK_GPIO=36
CONFIG_MOSI_GPIO=35
CONFIG_CS_GPIO=21
CONFIG_RST_GPIO=38
CONFIG_PARTITION_TABLE_CUSTOM_FILENAME="partitions_esp32s3.csv"
CONFIG_PARTITION_TABLE_FILENAME="partitions_esp32s3.csv"
```

## aquacontrol_sender/fw/sdkconfig.defaults
```kconfig
CONFIG_IDF_TARGET="esp32c3"
CONFIG_MISO_GPIO=5
CONFIG_SCK_GPIO=4
CONFIG_MOSI_GPIO=6
CONFIG_CS_GPIO=7
CONFIG_RST_GPIO=3
CONFIG_ESP_WIFI_ENABLED=n
CONFIG_ESP_DEFAULT_CPU_FREQ_MHZ_80=y
CONFIG_ESP_DEFAULT_CPU_FREQ_MHZ=80
CONFIG_PARTITION_TABLE_TWO_OTA=y
CONFIG_BT_ENABLED=y
CONFIG_BT_NIMBLE_ENABLED=y
CONFIG_ESPTOOLPY_FLASHSIZE_4MB=y
CONFIG_ESPTOOLPY_FLASHSIZE="4MB"
```
